## configs/DolphinPi_defconfig
```kconfig
# ARCH
CONFIG_ARM=y
CONFIG_ARCH_SUNXI=y
CONFIG_MACH_SUN8I_H3=y
CONFIG_DRAM_CLK=408
CONFIG_DRAM_ZQ=3881979
CONFIG_SUN8I_EMAC=y
CONFIG_DM_ETH=y
CONFIG_MII=y
CONFIG_DM_MDIO_MUX=y
# CONFIG_DRAM_ODT_EN is not set
# CONFIG_VIDEO_DT_SIMPLEFB is not set
# CONFIG_CLK_SUN8I_H3 is not set
# CONFIG_CONSOLE_MUX is not set
# # CONFIG_SYS_CONSOLE_IS_IN_ENV is not set
CONFIG_SYS_TEXT_BASE=0x42e00000

# DTS
CONFIG_DEFAULT_DEVICE_TREE="sun8i-v3s-dolphinpi"

# COMMON
CONFIG_SPL=y

# DEBUG
CONFIG_LOGLEVEL=7
CONFIG_CONS_INDEX=1

# UBI
CONFIG_MTD_UBI=y
CONFIG_MTD_UBI_FASTMAP=y
CONFIG_MTD_UBI_FASTMAP_AUTOCONVERT=y
CONFIG_CMD_UBI=y
CONFIG_CMD_UBIFS=y
CONFIG_RBTREE=y
CONFIG_MTD_DEVICE=y
CONFIG_MTD_PARTITIONS=y
CONFIG_CMD_MTDPARTS=y
CONFIG_LZO=y
CONFIG_LZMA=y

# ENV
CONFIG_ENV_IS_IN_FAT=n
CONFIG_ENV_IS_IN_UBI=y
CONFIG_ENV_UBI_PART="ubi0"
CONFIG_ENV_UBI_VOLUME="ubootenv"
CONFIG_ENV_UBI_VOLUME_REDUND="ubootenv2"


# BOOT
CONFIG_MTDIDS_DEFAULT="spi-nand0=0"
CONFIG_MTDPARTS_DEFAULT="mtdparts=0:1M(boot),-(ubi0)"
CONFIG_BOOTCOMMAND="ubifsmount ubi0:kernel; ubifsload $kernel_addr_r uImage; ubifsload $fdt_addr_r dtb; bootm $kernel_addr_r - $fdt_addr_r"
CONFIG_USE_BOOTARGS=y
CONFIG_BOOTARGS="console=ttyS0,115200 earlyprintk panic=5 rootwait ubi.mtd=1,2048 rootfstype=ubifs root=ubi0:rootfs rw"

### NOR
## SPI
# CONFIG_SPI=y
# CONFIG_SPI_BOOT=y
# CONFIG_SUNXI_SPI=y
# CONFIG_SPL_SPI_SUPPORT=y
# CONFIG_SPL_SPI_SUNXI=y

### NAND
CONFIG_CLK=y
CONFIG_CLK_SUNXI=y
CONFIG_CLK_SUN8I_V3S=y
CONFIG_SUNXI_SPI=y
CONFIG_SPI_SUNXI=y
CONFIG_CMD_MTD=y
CONFIG_MTD=y
CONFIG_MTD_SPI_NAND=y
CONFIG_SPI=y
CONFIG_SPI_MEM=y
CONFIG_SPI_SUNXI=y
CONFIG_SPL_SPINAND_SUNXI=y
CONFIG_DM=y
CONFIG_DM_SPI=y
CONFIG_CMD_DM=y
CONFIG_CMD_SPI=y
CONFIG_SPL_SPINAND_SUNXI_SPL_USE_GENERIC2K_ON_UNKNOWN=y
```

## configs/GenericV3sBoard_SPINAND_UART2_defconfig
```kconfig
# ARCH
CONFIG_ARM=y
CONFIG_ARCH_SUNXI=y
CONFIG_MACH_SUN8I_V3S=y
CONFIG_DRAM_CLK=360
CONFIG_DRAM_ZQ=14779

# DTS
CONFIG_DEFAULT_DEVICE_TREE="sun8i-v3s-rawspinandaccessuart2"
CONFIG_OF_LIBFDT_OVERLAY=y

# COMMON
CONFIG_SPL=y

# DEBUG
CONFIG_LOGLEVEL=7
CONFIG_CONS_INDEX=3

### ENV
CONFIG_ENV_IS_NOWHERE=y

### NAND
CONFIG_CLK=y
CONFIG_CLK_SUNXI=y
CONFIG_CLK_SUN8I_V3S=y
CONFIG_SUNXI_SPI=y
CONFIG_SPI_SUNXI=y
CONFIG_CMD_MTD=y
CONFIG_MTD=y
CONFIG_MTD_SPI_NAND=y
CONFIG_SPI=y
CONFIG_SPI_MEM=y
CONFIG_SPI_SUNXI=y
CONFIG_SPL_SPINAND_SUNXI=y
CONFIG_DM=y
CONFIG_DM_SPI=y
CONFIG_CMD_DM=y
CONFIG_CMD_SPI=y
CONFIG_SPL_SPINAND_SUNXI_SPL_USE_GENERIC2K_ON_UNKNOWN=y
```

## configs/LicheePi_Zero_SPINAND_defconfig
```kconfig
# ARCH
CONFIG_ARM=y
CONFIG_ARCH_SUNXI=y
CONFIG_MACH_SUN8I_V3S=y
CONFIG_DRAM_CLK=360
CONFIG_DRAM_ZQ=14779
CONFIG_SUN8I_EMAC=y
CONFIG_DM_ETH=y
CONFIG_MII=y
CONFIG_DM_MDIO_MUX=y

# DTS
CONFIG_DEFAULT_DEVICE_TREE="sun8i-v3s-licheepi-zero-spinand"

# COMMON
CONFIG_SPL=y

# DEBUG
CONFIG_LOGLEVEL=7

# UBI
CONFIG_MTD_UBI=y
CONFIG_MTD_UBI_FASTMAP=y
CONFIG_MTD_UBI_FASTMAP_AUTOCONVERT=y
CONFIG_CMD_UBI=y
CONFIG_CMD_UBIFS=y
CONFIG_RBTREE=y
CONFIG_MTD_DEVICE=y
CONFIG_MTD_PARTITIONS=y
CONFIG_CMD_MTDPARTS=y
CONFIG_LZO=y
CONFIG_LZMA=y

# ENV
CONFIG_ENV_IS_IN_FAT=n
CONFIG_ENV_IS_IN_UBI=y
CONFIG_ENV_UBI_PART="ubi0"
CONFIG_ENV_UBI_VOLUME="ubootenv"
CONFIG_ENV_UBI_VOLUME_REDUND="ubootenv2"


# BOOT
CONFIG_MTDIDS_DEFAULT="spi-nand0=0"
CONFIG_MTDPARTS_DEFAULT="mtdparts=0:1M(boot),-(ubi0)"
CONFIG_BOOTCOMMAND="ubifsmount ubi0:kernel; ubifsload $kernel_addr_r uImage; ubifsload $fdt_addr_r dtb; bootm 0x41000000 - 0x41800000"
CONFIG_USE_BOOTARGS=y
CONFIG_BOOTARGS="console=ttyS0,115200 earlyprintk panic=5 rootwait ubi.mtd=1,2048 rootfstype=ubifs root=ubi0:rootfs rw"

### NOR
## SPI
# CONFIG_SPI=y
# CONFIG_SPI_BOOT=y
# CONFIG_SUNXI_SPI=y
# CONFIG_SPL_SPI_SUPPORT=y
# CONFIG_SPL_SPI_SUNXI=y

### NAND
CONFIG_CLK=y
CONFIG_CLK_SUNXI=y
CONFIG_CLK_SUN8I_V3S=y
CONFIG_SUNXI_SPI=y
CONFIG_SPI_SUNXI=y
CONFIG_CMD_MTD=y
CONFIG_MTD=y
CONFIG_MTD_SPI_NAND=y
CONFIG_SPI=y
CONFIG_SPI_MEM=y
CONFIG_SPI_SUNXI=y
CONFIG_SPL_SPINAND_SUNXI=y
CONFIG_DM=y
CONFIG_DM_SPI=y
CONFIG_CMD_DM=y
CONFIG_CMD_SPI=y
CONFIG_SPL_SPINAND_SUNXI_SPL_USE_GENERIC2K_ON_UNKNOWN=y
```

## configs/orangepi_zero_defconfig
```kconfig
CONFIG_ARM=y
CONFIG_ARCH_SUNXI=y
CONFIG_FIT=y
CONFIG_MACH_SUN8I_H3=y
CONFIG_DRAM_CLK=672
CONFIG_DRAM_ZQ=3881979
CONFIG_DRAM_ODT_EN=y
CONFIG_DEFAULT_DEVICE_TREE="sun8i-h2-plus-orangepi-zero"
# CONFIG_SYS_MALLOC_CLEAR_ON_INIT is not set
CONFIG_CONSOLE_MUX=y
CONFIG_SPL=y
CONFIG_CMD_SF=y
CONFIG_CMD_SPI=y
# CONFIG_CMD_IMLS is not set
# CONFIG_CMD_FLASH is not set
# CONFIG_CMD_FPGA is not set
CONFIG_SUN8I_EMAC=y
CONFIG_USB_EHCI_HCD=y
CONFIG_SPL_SPI_SUNXI=y
CONFIG_DM_SPI_FLASH=y
CONFIG_SPI_FLASH=y
CONFIG_SPI_FLASH_MACRONIX=y
CONFIG_DM_SPI=y
CONFIG_SUNXI_SPI=y
```
